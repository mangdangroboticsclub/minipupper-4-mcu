## components/mpx_policy/Kconfig
```kconfig
menu "RL policy on the robot (mpx_policy)"

    config MP4_POLICY_ENABLE
        bool "Run RL walk policies on the ESP32-S3 (`policy` console command)"
        default y

    config MP4_POLICY_ROBOT
        string "This robot (a policy for another one needs `force`)"
        default "sku1"
        depends on MP4_POLICY_ENABLE
        help
            Compared with the robot named in a policy file. A policy trained
            on another robot's model (another body, other servos) can do
            anything on this one, so it does not start without `force`.

    config MP4_POLICY_INTERNAL_RESERVE_KB
        int "Keep the network in internal RAM if this much (KB) stays free"
        default 96
        range 0 1024
        depends on MP4_POLICY_ENABLE
        help
            The network's weights (about 130 KB) are read in full at every
            50 Hz step. From internal RAM that takes well under a
            millisecond; from PSRAM several. The policy goes to internal
            RAM when, after it, at least this much internal RAM is still
            free (Wi-Fi, TLS and the tasks need it); otherwise to PSRAM.
            0: always PSRAM.

endmenu
```

## components/mpx_uros/Kconfig
```kconfig
menu "micro-ROS (ROS 2 on the ESP32-S3)"

    config MP4_UROS_ENABLE
        bool "Start the micro-ROS node"
        default y
        help
            The robot is a ROS 2 node on Wi-Fi. It needs a micro-ROS agent on
            a PC (README_UROS.md). The agent's address is set at run time with
            `uros agent <ip>` on the serial console; until then the node
            waits and costs nothing.

    config MP4_UROS_AGENT_IP
        string "Default agent IP (empty = set it with `uros agent <ip>`)"
        default ""
        depends on MP4_UROS_ENABLE

    config MP4_UROS_AGENT_PORT
        int "Default agent UDP port"
        range 1 65535
        default 8888
        depends on MP4_UROS_ENABLE

    config MP4_UROS_DOMAIN_ID
        int "Default ROS_DOMAIN_ID"
        range 0 232
        default 0
        depends on MP4_UROS_ENABLE

    config MP4_UROS_IMU_HZ
        int "Default imu/data_raw rate (Hz, 0 = off)"
        range 0 200
        default 100
        depends on MP4_UROS_ENABLE

    config MP4_UROS_JOINT_HZ
        int "Default joint_states rate (Hz, 0 = off)"
        range 0 100
        default 50
        depends on MP4_UROS_ENABLE

endmenu
```

## main/Kconfig.projbuild
```kconfig
menu "Pi link"

    config APP_PI_LINK_UART_BAUD
        int "Pi link UART baud rate"
        default 921600
        range 9600 5000000
        help
            UART1 on the J-PI connector (pins in board_config.h). Must match
            the host's baud rate; 921600 is the robot's default.

    config APP_RL_TICK_HZ
        int "Servo exchange and STATE rate (Hz)"
        default 200
        range 50 200
        help
            One frame to each of the four servo boards per tick, and one STATE
            frame to the host.

    config APP_RL_WATCHDOG_MS
        int "Link watchdog (ms)"
        default 100
        range 20 1000
        help
            Armed and no SET_ALL for this long: every servo IDLE.

    config APP_RL_GUARD_CUR_MA
        int "Guard: current limit (mA)"
        default 1000
        range 100 5000
        help
            A driven servo above this current for APP_RL_GUARD_CUR_MS disarms
            every servo. The default acts near stall only, and the temperature
            guard is the main motor protection; a lower limit protects the
            gear trains more but trips under heavy load.

    config APP_RL_GUARD_CUR_MS
        int "Guard: time above the current limit (ms)"
        default 500
        range 10 10000

    config APP_RL_GUARD_TEMP_DC
        int "Guard: housing temperature limit (0.1 degC)"
        default 600
        range 300 1000
        help
            A driven servo's housing above this for APP_RL_GUARD_TEMP_MS
            disarms every servo.

    config APP_RL_GUARD_TEMP_MS
        int "Guard: time above the temperature limit (ms)"
        default 1000
        range 10 10000

    config APP_RL_USB_LINK
        bool "Also accept the protocol on UART0 (USB)"
        default n
        depends on ESP_CONSOLE_NONE
        help
            UART0 (the CH340K USB port) speaks the same protocol as the Pi
            link, for bench work from a PC. Needs the console turned off
            (Component config -> ESP System Settings -> Channel for console
            output -> No console output).

    config APP_RL_USB_BAUD
        int "USB link baud rate"
        default 921600
        range 9600 3000000
        depends on APP_RL_USB_LINK

endmenu
```
